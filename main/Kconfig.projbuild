## main/Kconfig.projbuild
```kconfig
menu "SkelApp Configuration"

    orsource "$IDF_PATH/examples/common_components/env_caps/$IDF_TARGET/Kconfig.env_caps"
 
    menuconfig RGB_LED
        bool "RGB LED"
        default y
        help
            When enabled the firmware includes support for
            the on-board RGB LED.
                    
    config RGB_LED_GPIO
        int "RGB LED GPIO Number"
        depends on RGB_LED
        range ENV_GPIO_RANGE_MIN ENV_GPIO_OUT_RANGE_MAX
        default 5 if IDF_TARGET_ESP32
        default 8 if IDF_TARGET_ESP32C3
        default 48 if IDF_TARGET_ESP32S3
        default 8
        help
            GPIO pin number used to control the RGB LED.
                
    config RGB_LED_TASK_PRIO
        int "RGB LED Task Priority"
        depends on RGB_LED
        range 0 24
        default 24
        help
            The priority of the task that manages the RGB LED.
             The valid range is: 0 to (configMAX_PRIORITIES-1).
             The RGB LED task consumes little CPU, so it is OK
             to give it a high priority to keep the LED blinking
             rate accurate.

    menuconfig MSG_LOG
        bool "Message Logging"
        default y
        help
            When enabled the firmware includes support for
            message logging to the console or a file.
            
    choice MSG_LOG_LEVEL
        prompt "Message Log Level"
        depends on MSG_LOG
        default MSG_LOG_LEVEL_INFO
        config MSG_LOG_LEVEL_NONE
            bool "No logging"
        config MSG_LOG_LEVEL_INFO
            bool "Informational"
        config MSG_LOG_LEVEL_TRACE 
            bool "Code Tracing"
        config MSG_LOG_LEVEL_DEBUG 
            bool "Code Debugging"
    endchoice            
            
    config MSG_LOG_LEVEL
        int
        depends on MSG_LOG
        default 0 if MSG_LOG_LEVEL_NONE     # must match C enum LogLevel.none 
        default 1 if MSG_LOG_LEVEL_INFO     # must match C enum LogLevel.info
        default 2 if MSG_LOG_LEVEL_TRACE    # must match C enum LogLevel.trace 
        default 3 if MSG_LOG_LEVEL_DEBUG    # must match C enum LogLevel.debug

    choice MSG_LOG_DEST
        prompt "Message Log Destination"
        depends on MSG_LOG
        default MSG_LOG_DEST_CONSOLE
        config MSG_LOG_DEST_CONSOLE
            bool "Console"
        config MSG_LOG_DEST_FILE
            bool "File on FAT FS"
            depends on FAT_FS
        config MSG_LOG_DEST_BOTH 
            bool "Console and File"
            depends on FAT_FS
    endchoice
    
    config MSG_LOG_DEST
        int
        depends on MSG_LOG
        default 0 if MSG_LOG_DEST_CONSOLE   # must match C enum LogDest.console
        default 1 if MSG_LOG_DEST_FILE      # must match C enum LogDest.file
        default 2 if MSG_LOG_DEST_BOTH      # must match C enum LogDest.both
        
    choice MSG_LOG_TIMESTAMP
        prompt "Message Log Timestamp"
        depends on MSG_LOG
        default MSG_LOG_TS_UPTIME_MSEC
        config MSG_LOG_TS_UPTIME_USEC
            bool "Up-time (HH:MM:SS.usec)"
        config MSG_LOG_TS_UPTIME_MSEC
            bool "Up-time HH:MM:SS.msec"
        config MSG_LOG_TS_TOD_USEC 
            bool "Date and Time (usec)"
            depends on WIFI_NTP
        config MSG_LOG_TS_TOD_MSEC 
            bool "Date and Time (msec)"
            depends on WIFI_NTP
    endchoice
        
    config MSG_LOG_TIMESTAMP
        bool
        depends on MSG_LOG
        default MSG_LOG_TS_UPTIME_MSEC
            
    config MSG_LOG_MAX_LEN
        int "Max Length of Message Text"
        depends on MSG_LOG
        default 256
        help
            Indicates the maximum length of the text in a single log message.
            Used to dimension the memory buffer where the text is formatted.
        
    config MSG_LOG_DUMP
        bool "Message Log Dump"
        depends on MSG_LOG && FAT_FS
        default y
        help
            When enabled the message log file is dumped to the console when
            the system starts up. 
            
    menuconfig BLE_PERIPHERAL
        bool "BLE Peripheral"
        depends on BT_NIMBLE_ENABLED
        default y
        help
            When enabled the firmware includes BLE peripheral functionality
            to allow a mobile app to connect to the device.
                
    config BLE_HOST_TASK_PRIO
        int "BLE Host Task Priority"
        depends on BLE_PERIPHERAL
        range 0 24
        default 20
        help
            The priority of the task that runs the BLE Host stack.
            The valid range is: 0 to (configMAX_PRIORITIES-1).
            
    config BLE_HOST_TASK_STACK
        int "BLE Host Task Stack Size"
        depends on BLE_PERIPHERAL
        range 4096 8192
        default 4096
        help
            The stack size of the BLE Host task.
            
    choice BLE_HOST_TASK_CPU
        prompt "BLE Host Task CPU Affinity"
        depends on BLE_PERIPHERAL
        default BLE_HOST_TASK_CPU_NO_AFFINITY
        help
            The CPU core of the BLE Host task.

        config BLE_HOST_TASK_CPU_NO_AFFINITY
            bool "No affinity"
        config BLE_HOST_TASK_CPU_CORE0
            bool "CPU0"
        config BLE_HOST_TASK_CPU_CORE1 
            bool "CPU1"
    endchoice
                
    config BLE_HOST_TASK_CPU
        hex
        depends on BLE_PERIPHERAL
        default FREERTOS_NO_AFFINITY if BLE_HOST_TASK_CPU_NO_AFFINITY
        default 0x0 if BLE_HOST_TASK_CPU_CORE0
        default 0x1 if BLE_HOST_TASK_CPU_CORE1
                
    config BLE_ADV_NAME
        string "BLE Advertised Name"
        depends on BLE_PERIPHERAL
        default "SKELAPP"
        help
            The base name used in the BLE advertisements. The actual name sent
            in the advertisements has the suffix "-NNNN" appended to it, where 
            NNNN are four hex digits derived from the serial number of the device.

    config DEVICE_INFO_SERVICE
        bool "Device Information Service"
        depends on BLE_PERIPHERAL
        default y
        help
            When enabled the firmware includes the standard Device Information
            Service.
                                
    config MANUFACTURER_NAME
        string "Manufacturer Name"
        depends on DEVICE_INFO_SERVICE
        default "Acme Corporation"
        help
            The string used as the Manufacturer Name in the Device Information
            Service.
                
    config MODEL_NUMBER
        string "Model Number"
        depends on DEVICE_INFO_SERVICE
        default "Wilie Coyote 007"
        help
            The string used as the Model Number in the Device Information
            Service.
    
    config DEVICE_CONFIG_SERVICE_UUID
        hex "Device Config Service UUID"
        depends on BLE_PERIPHERAL
        default 0xFE00
        help
            The 16-bit UUID to use for the custom Device Configuration Service.         
        
    config DEVICE_CONFIG_SERVICE_HELP
        bool "Device Config Service Help"
        depends on BLE_PERIPHERAL
        default y
        help
            When enabled the firmware includes built-in help for the custom
            Device Configuration Service.            
    
    menuconfig WIFI_STATION
        bool "WiFi Station"
        depends on ESP_WIFI_ENABLED
        default y
        help
            When enabled the firmware includes WiFi station functionality
            to allow the device to connect to the Internet.
    
    config WPS
        bool "WiFi Protected Setup (WPS)"
        depends on WIFI_STATION
        default y
        help
            Adds support for WiFi Protected Setup (WPS) to auto configure the 
            WiFi credentials using the WiFi router.
                
    config WIFI_SSID
        string "WiFi SSID"
        depends on WIFI_STATION
        help
            Hardcoded WiFi SSID.
                
    config WIFI_PASSWD
        string "WiFi Password"
        depends on WIFI_STATION
        help
            Hardcoded WiFi password.

    config WIFI_NTP
        bool "Network Time Protocol"
        depends on WIFI_STATION
        default y
        help
            Use NTP to obtain the current date and time.
            
    config WIFI_NTP_SERVER
        string "NTP Server"
        depends on WIFI_NTP
        default "pool.ntp.org"
        help
            Specifies the FQDN of the NTP server to use to set the
            current date and time.
    
    menuconfig OTA_UPDATE
        bool "OTA Update"
        depends on WIFI_STATION && PARTITION_TABLE_CUSTOM
        help
            Add support for OTA firmware update over WiFi.

    config OTA_SERVER_FQDN
        string "OTA Server FQDN"
        depends on OTA_UPDATE
        default "ota.acme.com"
        help
            The FQDN (or IPv4 address) of the remote OTA server.

    config OTA_TCP_PORT
        int "OTA TCP Port"
        depends on OTA_UPDATE
        range 1024 65536
        default 8070
        help
            The TCP port for the HTTPS connection to the remote
            OTA server.
        
     config OTA_TASK_PRIO
        int "OTA Update Task Priority"
        depends on OTA_UPDATE
        range 0 24
        default 10
        help
            The priority of the OTA Update task. The valid range is: 
            0 to (configMAX_PRIORITIES-1).

    config OTA_TASK_STACK
        int "OTA Update Task Stack Size"
        depends on OTA_UPDATE
        range 5120 8192
        default 5120
        help
            The stack size of the OTA Update task.
            
    choice OTA_TASK_CPU
        prompt "OTA Update Task CPU Affinity"
        depends on OTA_UPDATE
        default OTA_TASK_CPU_NO_AFFINITY
        help
            The CPU core of the OTA Update task.

        config OTA_TASK_CPU_NO_AFFINITY
            bool "No affinity"
        config OTA_TASK_CPU_CORE0
            bool "CPU0"
        config OTA_TASK_CPU_CORE1 
            bool "CPU1"
    endchoice
                
    config OTA_TASK_CPU
        hex
        depends on OTA_UPDATE
        default FREERTOS_NO_AFFINITY if OTA_TASK_CPU_NO_AFFINITY
        default 0x0 if OTA_TASK_CPU_CORE0
        default 0x1 if OTA_TASK_CPU_CORE1
 
     menuconfig APP_MAIN_TASK
         bool "AppMain Task"
         default y
        help
            Have app_main() spawn the event-driven appMainTask, and exit.
     
     config MAIN_TASK_PRIO
        int "Priority"
        depends on APP_MAIN_TASK
        range 0 24
        default 10
        help
            The priority of the app's main task, spawned by app_main()
            during start up.
            The valid range is: 0 to (configMAX_PRIORITIES-1).
                   
    config MAIN_TASK_STACK
        int "Stack Size"
        depends on APP_MAIN_TASK
        range 3072 8192
        default 4096
        help
            The stack size of the app's main task, spawned by app_main() 
            during start up.
            
    choice MAIN_TASK_CPU
        prompt "CPU Affinity"
        depends on APP_MAIN_TASK
        default MAIN_TASK_CPU_NO_AFFINITY
        help
            The CPU core of the app's main task.

        config MAIN_TASK_CPU_NO_AFFINITY
            bool "No affinity"
        config MAIN_TASK_CPU_CORE0
            bool "CPU0"
        config MAIN_TASK_CPU_CORE1 
            bool "CPU1"
    endchoice
                
    config MAIN_TASK_CPU
        hex
        depends on APP_MAIN_TASK
        default FREERTOS_NO_AFFINITY if MAIN_TASK_CPU_NO_AFFINITY
        default 0x0 if MAIN_TASK_CPU_CORE0
        default 0x1 if MAIN_TASK_CPU_CORE1

    choice MAIN_TASK_WAKEUP_METHOD
        prompt "Wakeup Method"
        depends on APP_MAIN_TASK
        default APP_MAIN_TASK_WAKEUP_METHOD_TASK_DELAY
        help
            The wake up method used by the AppMain task.

        config APP_MAIN_TASK_WAKEUP_METHOD_TASK_DELAY
            bool "Task Delay"
        config APP_MAIN_TASK_WAKEUP_METHOD_ESP_TIMER
            bool "Timer Alarm"
    endchoice
    
    config MAIN_TASK_WAKEUP_METHOD
        int
        depends on APP_MAIN_TASK
        default 0 if APP_MAIN_TASK_WAKEUP_METHOD_TASK_DELAY
        default 1 if APP_MAIN_TASK_WAKEUP_METHOD_ESP_TIMER
    
    config MAIN_TASK_WAKEUP_PERIOD
        int "Wakeup Period"
        depends on APP_MAIN_TASK
        range 1 10000
        default 1000
        help
            The period (in milliseconds) of the main task's wakeup
            event. When MAIN_TASK_WAKEUP_METHOD is TASK_DELAY, this 
            value must be consistent with the period of the system 
            clock tick as defined by CONFIG_FREERTOS_HZ.
            
    config MAIN_TASK_TIME_WORK_LOOP
        bool "Time Work Loop"
        depends on APP_MAIN_TASK
        default n
        help
            Time the execution of the main tasks's work loop.

    menuconfig FAT_FS
        bool "FAT File System"
        depends on PARTITION_TABLE_CUSTOM
        default y
        help
            Create a FAT file system using the 'storage' partition
            in flash memory.
 
     config FAT_FS_MOUNT_POINT
        string "Mount Point"
        depends on FAT_FS
        default "/fatfs"
        help
            Specifies the mount point of the FAT FS.
            
    config FAT_FS_MAX_FILES
        int "File Limit"
        depends on FAT_FS
        range 1 256
        default 4
        help
            Specifies the maximum number of files that can be stored
            in the FAT FS.
    
    config FAT_FS_LIST_FILES
        bool "List Files"
        depends on FAT_FS
        default y
        help
            When the system boots, list the files stored on the FAT FS.
            
endmenu
```
